## sdkconfig.defaults
```kconfig
CONFIG_IDF_TARGET="esp32p4"
CONFIG_IDF_EXPERIMENTAL_FEATURES=y
CONFIG_ESPTOOLPY_FLASHSIZE_16MB=y
CONFIG_SPIRAM=y
CONFIG_FREERTOS_TASK_CREATE_ALLOW_EXT_MEM=y
CONFIG_COMPILER_OPTIMIZATION_SIZE=y
CONFIG_FATFS_LFN_HEAP=y
CONFIG_FATFS_MAX_LFN=255

# CONFIG_LV_BUILD_EXAMPLES is not set
# CONFIG_LV_BUILD_DEMOS is not set

CONFIG_BSP_I2C_NUM=0
# CONFIG_BSP_ERROR_CHECK is not set
# CONFIG_BSP_SD_FORMAT_ON_MOUNT_FAIL is not set
# CONFIG_BSP_SPIFFS_FORMAT_ON_MOUNT_FAIL is not set
CONFIG_ESP_MAIN_TASK_STACK_SIZE=24576
CONFIG_LV_USE_TINY_TTF=y
CONFIG_LV_TINY_TTF_FILE_SUPPORT=n
CONFIG_LV_USE_DEMO_WIDGETS=n

CONFIG_FATFS_API_ENCODING_UTF_8=y

CONFIG_PARTITION_TABLE_CUSTOM=y
CONFIG_PARTITION_TABLE_CUSTOM_FILENAME="partitions.csv"

CONFIG_PTHREAD_TASK_STACK_SIZE_DEFAULT=24576

# Allocate widget/font memory from PSRAM rather than a fixed 64 KiB TLSF pool.
CONFIG_LV_USE_CUSTOM_MALLOC=y
CONFIG_SLAVE_IDF_TARGET_ESP32C6=y
CONFIG_ESP_HOSTED_SDIO_GPIO_RESET_SLAVE=15
CONFIG_ESP_HOSTED_SDIO_PIN_CMD=13
CONFIG_ESP_HOSTED_SDIO_PIN_CLK=12
CONFIG_ESP_HOSTED_SDIO_PIN_D0=11
CONFIG_ESP_HOSTED_SDIO_PRIV_PIN_D1_4BIT_BUS=10
CONFIG_ESP_HOSTED_SDIO_PIN_D2=9
CONFIG_ESP_HOSTED_SDIO_PIN_D3=8
CONFIG_ESP_HOSTED_SDIO_CLOCK_FREQ_KHZ=20000
# CONFIG_ESP_HOSTED_SDIO_OPTIMIZATION_RX_NONE is not set
CONFIG_MBEDTLS_CERTIFICATE_BUNDLE=y
# CONFIG_MBEDTLS_CERTIFICATE_BUNDLE_DEFAULT_CMN is not set

CONFIG_CAMERA_SC202CS=y

CONFIG_CAMERA_SC202CS_AUTO_DETECT_MIPI_INTERFACE_SENSOR=y

CONFIG_CAMERA_SC202CS_MIPI_RAW8_1280X720_30FPS=y

CONFIG_CAMERA_SC202CS_MIPI_DEFAULT_FMT_RAW8_1280X720_30FPS=y

CONFIG_ESP_VIDEO_ENABLE_ISP_PIPELINE_CONTROLLER=y

CONFIG_MBEDTLS_EXTERNAL_MEM_ALLOC=y
CONFIG_MBEDTLS_CERTIFICATE_BUNDLE_DEFAULT_FULL=y
CONFIG_HTTPD_MAX_REQ_HDR_LEN=2048

CONFIG_BOOTLOADER_APP_ROLLBACK_ENABLE=y

CONFIG_MBEDTLS_TLS_CLIENT_ONLY=y

# CONFIG_MBEDTLS_KEY_EXCHANGE_RSA is not set

# CONFIG_MBEDTLS_KEY_EXCHANGE_ECDH_ECDSA is not set

# CONFIG_MBEDTLS_KEY_EXCHANGE_ECDH_RSA is not set

# CONFIG_MBEDTLS_PKCS7_C is not set

# CONFIG_MBEDTLS_SSL_RENEGOTIATION is not set

CONFIG_LOG_DEFAULT_LEVEL_WARN=y

# Meshtastic GATT central over the C6; no classic Bluetooth.
CONFIG_BT_ENABLED=y
CONFIG_BT_NIMBLE_ENABLED=y
CONFIG_BT_CONTROLLER_DISABLED=y
CONFIG_BT_NIMBLE_TRANSPORT_UART=n
CONFIG_ESP_HOSTED_ENABLE_BT_NIMBLE=y
CONFIG_BT_NIMBLE_ROLE_CENTRAL=y
CONFIG_BT_NIMBLE_ROLE_OBSERVER=y
CONFIG_BT_NIMBLE_ROLE_PERIPHERAL=n
CONFIG_BT_NIMBLE_ROLE_BROADCASTER=n
CONFIG_BT_NIMBLE_SECURITY_ENABLE=y
CONFIG_BT_NIMBLE_SM_LEGACY=y
CONFIG_BT_NIMBLE_SM_SC=y
CONFIG_BT_NIMBLE_MAX_CONNECTIONS=1

# CONFIG_BT_NIMBLE_NVS_PERSIST is not set

CONFIG_BT_NIMBLE_CRYPTO_STACK_MBEDTLS=y
CONFIG_BT_NIMBLE_LOG_LEVEL_WARNING=y

CONFIG_SPIRAM_TRY_ALLOCATE_WIFI_LWIP=y

CONFIG_MBEDTLS_HAVE_TIME_DATE=y

# Factory C6 1.4.1 sends aggregated SDIO streams, not isolated packets.
CONFIG_ESP_HOSTED_SDIO_OPTIMIZATION_RX_STREAMING_MODE=y

CONFIG_COMPILER_CXX_EXCEPTIONS=y

# All application preferences and credentials belong to /SymbianOS on SD.
# CONFIG_WIFI_RMT_NVS_ENABLED is not set
# CONFIG_ESP_WIFI_NVS_ENABLED is not set

CONFIG_COMPILER_CXX_EXCEPTIONS_EMG_POOL_SIZE=4096
```
